## src/drivers/smmstore/Kconfig
```kconfig
##
## This file is part of the coreboot project.
##
## This program is free software; you can redistribute it and/or modify
## it under the terms of the GNU General Public License as published by
## the Free Software Foundation; version 2 of the License.
##
## This program is distributed in the hope that it will be useful,
## but WITHOUT ANY WARRANTY; without even the implied warranty of
## MERCHANTABILITY or FITNESS FOR A PARTICULAR PURPOSE.  See the
## GNU General Public License for more details.
##

config SMMSTORE
	bool "Support for flash based, SMM mediated data store"
	depends on BOOT_DEVICE_SUPPORTS_WRITES
	default y if PAYLOAD_TIANOCORE
	select SPI_FLASH_SMM if BOOT_DEVICE_SPI_FLASH_RW_NOMMAP

config SMMSTOREV2
	bool "Implement version 2 of SMM API"
	depends on SMMSTORE
	default y if PAYLOAD_TIANOCORE
	help
	  Version 2 of the SSMSTORE allows secure communication with the SMM
	  and makes no asumptions of the data structure stored in the store.
	  It splits the store into chunks to allows fault tolerant writes.

config SMMSTORE_IN_CBFS
	bool
	default n
	help
	  Select this if you want to add an SMMSTORE region to a
	  cbfsfile in a cbfs FMAP region

if SMMSTORE
config SMMSTORE_REGION
	string "fmap region in which SMM store file is kept" if SMMSTORE_IN_CBFS
	default "RW_LEGACY" if CHROMEOS && SMMSTORE_IN_CBFS
	default "COREBOOT" if SMMSTORE_IN_CBFS
	default "SMMSTORE"

config SMMSTORE_FILENAME
	string "SMM store file name" if SMMSTORE_IN_CBFS
	default "smm_store"

config SMMSTORE_SIZE
	hex "size of the SMMSTORE FMAP region"
	depends on !SMMSTORE_IN_CBFS
	default 0x40000
	help
	  Sets the size of the default SMMSTORE FMAP region.
	  If using an UEFI payload, note that UEFI specifies at least 64K.
	  The current implementation of SMMSTORE is append only, so until
	  garbage collection is implemented it is better to set this to
	  a rather large value.

endif
```
